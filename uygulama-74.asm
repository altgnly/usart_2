	LIST P=16F877A
	#INCLUDE <P16F877A.INC>
	SAYICI1 EQU 0X20
	SAYICI2 EQU 0X21
	ORG 0X00
	GOTO ANA_METOT

ANA_METOT
	BANKSEL TRISC
	CLRF TRISC
	BANKSEL PORTC
	CLRF PORTB

	BANKSEL SPBRG
	MOVLW D'25'
	MOVWF SPBRG

	BANKSEL TXSTA
	MOVLW B'00100110'
	MOVWF TXSTA

	BANKSEL RCSTA
	MOVLW B'10000000'
	MOVWF RCSTA

KONTROL
	BTFSS PIR1,TXIF
	GOTO KONTROL

	MOVLW A'N'
	MOVWF TXREG
	CALL GECIKME
	
	MOVLW A'I'
	MOVWF TXREG
	CALL GECIKME

	MOVLW A'L'
	MOVWF TXREG
	CALL GECIKME

	MOVLW A'A'	
	MOVWF TXREG
	CALL GECIKME
	
	MOVLW A'Y'
	MOVWF TXREG
	CALL GECIKME

	MOVLW A' '
	MOVWF TXREG
	CALL GECIKME

	MOVLW A'A'
	MOVWF TXREG
	CALL GECIKME

	MOVLW A'H'
	MOVWF TXREG
	CALL GECIKME

	MOVLW A'M'
	MOVWF TXREG
	CALL GECIKME

	MOVLW A'E'	
	MOVWF TXREG
	CALL GECIKME
	
	MOVLW A'T'
	MOVWF TXREG
	CALL GECIKME

KONTROL_2
	GOTO KONTROL_2

GECIKME
	MOVLW D'60'
	MOVWF SAYICI1

TEKRAR1
	MOVLW D'130'
	MOVWF SAYICI2

TEKRAR2
	DECFSZ SAYICI2,F
	GOTO TEKRAR2
	DECFSZ SAYICI1,F
	GOTO TEKRAR1
	RETURN

END

	